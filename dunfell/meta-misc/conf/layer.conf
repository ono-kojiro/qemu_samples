## dunfell/meta-misc/conf/layer.conf
```bitbake
# We have a conf and classes directory, add to BBPATH
BBPATH .= ":${LAYERDIR}"

# We have recipes-* directories, add to BBFILES
BBFILES += "${LAYERDIR}/recipes-*/*/*.bb \
	${LAYERDIR}/recipes-*/*/*.bbappend"

BBFILE_COLLECTIONS += "misc"
BBFILE_PATTERN_misc = "^${LAYERDIR}/"
BBFILE_PRIORITY_misc = "6"
```

## yocto/meta-linux-4.14/conf/layer.conf
```bitbake
# We have a conf and classes directory, add to BBPATH
BBPATH .= ":${LAYERDIR}"

# We have recipes-* directories, add to BBFILES
BBFILES += "${LAYERDIR}/recipes-*/*/*.bb \
	${LAYERDIR}/recipes-*/*/*.bbappend"

BBFILE_COLLECTIONS += "linux-4.14"
BBFILE_PATTERN_linux-4.14 = "^${LAYERDIR}/"
BBFILE_PRIORITY_linux-4.14 = "6"
```
